## boards/shields/corne_trackpoint/Kconfig.defconfig
```kconfig
if SHIELD_CORNE_TRACKPOINT_RIGHT

config ZMK_KEYBOARD_NAME
    default "TP Corne"

comment "Peripheral role — ZMK_SPLIT_ROLE_CENTRAL not set, so this is a peripheral"

endif

if SHIELD_CORNE_TRACKPOINT_RIGHT || SHIELD_CORNE_TRACKPOINT_LEFT

config ZMK_SPLIT
    default y

endif
```

## boards/shields/corne_trackpoint/Kconfig.shield
```kconfig
config SHIELD_CORNE_TRACKPOINT_LEFT
    def_bool $(shields_list_contains,corne_trackpoint_left)

config SHIELD_CORNE_TRACKPOINT_RIGHT
    def_bool $(shields_list_contains,corne_trackpoint_right)
```

## boards/shields/trackpoint_dongle/Kconfig.defconfig
```kconfig
if SHIELD_TRACKPOINT_DONGLE

config ZMK_KEYBOARD_NAME
    default "TP Dongle"

config ZMK_SPLIT_ROLE_CENTRAL
    default y

config ZMK_SPLIT
    default y

config ZMK_SPLIT_BLE_CENTRAL_PERIPHERALS
    default 1

endif
```

## boards/shields/trackpoint_dongle/Kconfig.shield
```kconfig
config SHIELD_TRACKPOINT_DONGLE
    def_bool $(shields_list_contains,trackpoint_dongle)
```

## config/west.yml
```yaml
manifest:
  remotes:
    - name: zmkfirmware
      url-base: https://github.com/zmkfirmware
    - name: maged
      url-base: https://github.com/Magid-William
    - name: badjeff
      url-base: https://github.com/badjeff
  projects:
    - name: zmk
      remote: zmkfirmware
      revision: fa33e35f11d2b15311973cda9fb89dcd2376888c
      import: app/west.yml
    - name: zmk-pmw3610-driver
      remote: maged
      revision: 96b9c754b8820f818ed87f20041ba8cf66db641c
    - name: zmk-input-processor-report-rate-limit
      remote: badjeff
      revision: main
    - name: zmk-input-processor-xyz
      remote: badjeff
      revision: main
  self:
    path: config
```
